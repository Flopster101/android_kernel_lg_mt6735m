## drivers/misc/mediatek/cam_cal/Kconfig
```kconfig
config MTK_CAM_CAL
  bool CONFIG_MTK_CAM_CAL
  default n
  help
    CONFIG_MTK_CAM_CAL define if the camera cal driver should be built in or not
config MTK_CAM_CAL_COMMON
	string "MTK_CAM_CAL_COMMON"
	help
	  To support common camcal driver.

config MTK_CAM_CAL_LIST
	string "MTK_CAM_CAL_LIST"
	help
	  To support multiple camcal driver.
```

## drivers/misc/mediatek/chargepump/Kconfig
```kconfig
config LEDS_LM3632
         bool "LM3632 LED"
        default n

config LEDS_LM3639
        bool "LM3639 Support"
        default n

config LEDS_RT8542
        bool "RT8542 Support"
        default n

config LEDS_RT4832
        bool "RT4832 Support"
        default n
```
